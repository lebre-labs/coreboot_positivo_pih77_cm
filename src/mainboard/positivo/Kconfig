## src/mainboard/positivo/Kconfig
```kconfig
## SPDX-License-Identifier: GPL-2.0-only

if VENDOR_POSITIVO

choice
	prompt "Mainboard model"

source "src/mainboard/positivo/*/Kconfig.name"

endchoice

source "src/mainboard/positivo/*/Kconfig"

config MAINBOARD_VENDOR
	string
	default "Positivo"

endif # VENDOR_POSITIVO
```

## src/mainboard/positivo/pih77-cm/Kconfig
```kconfig
## SPDX-License-Identifier: GPL-2.0-only

if BOARD_POSITIVO_PIH77_CM

config BOARD_SPECIFIC_OPTIONS
	def_bool y
	select AZALIA_USE_LEGACY_VERB_TABLE
	select BOARD_ROMSIZE_KB_8192
	select HAVE_ACPI_RESUME
	select HAVE_ACPI_TABLES
	select INTEL_INT15
	select MAINBOARD_HAS_LIBGFXINIT
	select NORTHBRIDGE_INTEL_SANDYBRIDGE
	select SERIRQ_CONTINUOUS_MODE
	select SOUTHBRIDGE_INTEL_C216
	select USE_NATIVE_RAMINIT

config MAINBOARD_DIR
	string
	default "positivo/pih77-cm"

config MAINBOARD_PART_NUMBER
	string
	default "PIH77-CM"

config VGA_BIOS_ID
        string
        default "8086,0152"

config DRAM_RESET_GATE_GPIO # FIXME: check this
	int
	default 60

config USBDEBUG_HCD_INDEX # FIXME: check this
	int
	default 2
endif
```

## src/mainboard/positivo/pih77-cm/Kconfig.name
```kconfig
## SPDX-License-Identifier: GPL-2.0-only

config BOARD_POSITIVO_PIH77_CM
	bool "PIH77-CM"
```

## src/mainboard/positivo/piq77-cl/Kconfig
```kconfig
## SPDX-License-Identifier: GPL-2.0-only

if BOARD_POSITIVO_PIQ77_CL

config BOARD_SPECIFIC_OPTIONS
	def_bool y
	select AZALIA_USE_LEGACY_VERB_TABLE
	select BOARD_ROMSIZE_KB_8192
	select HAVE_ACPI_RESUME
	select HAVE_ACPI_TABLES
	select INTEL_INT15
	select NORTHBRIDGE_INTEL_SANDYBRIDGE
	select SERIRQ_CONTINUOUS_MODE
	select SOUTHBRIDGE_INTEL_C216
	select USE_NATIVE_RAMINIT

config MAINBOARD_DIR
	string
	default "positivo/piq77-cl"

config MAINBOARD_PART_NUMBER
	string
	default "PIQ77-CL"

config DRAM_RESET_GATE_GPIO # FIXME: check this
	int
	default 60

config USBDEBUG_HCD_INDEX # FIXME: check this
	int
	default 2
endif
```

## src/mainboard/positivo/piq77-cl/Kconfig.name
```kconfig
## SPDX-License-Identifier: GPL-2.0-only

config BOARD_POSITIVO_PIQ77_CL
	bool "PIQ77-CL"
```
